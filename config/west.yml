## config/west.yml
```yaml
manifest:
  remotes:
    - name: zmkfirmware
      url-base: https://github.com/zmkfirmware
    - name: sekigon-gonnoc
      url-base: https://github.com/sekigon-gonnoc
    - name: kot149
      url-base: https://github.com/kot149
    - name: cormoran
      url-base: https://github.com/cormoran
  projects:
    # DYA Studio(Level 2)対応のため、公式ZMK v0.3ではなくcormoran氏のフォークを使用。
    # 当初はv0.3-branch+custom-studio-protocol+bleを自己判断で選定したが、実機で
    # 接続不安定・タイムアウト等の問題が発生した。torabo-tsuki-lp本家(sekigon-gonnoc)に
    # 実際にDYA Studio対応済みブランチ(v0.3+dya-studio)が存在することが判明し、
    # そちらが使っているv0.3-branch+dyaに変更した。本家が実機検証済みの構成であり、
    # 以下のモジュール群もこの組み合わせで動作確認されている
    # （参考: https://github.com/sekigon-gonnoc/zmk-keyboard-torabo-tsuki-lp/tree/v0.3+dya-studio
    #  詳細はmemos/dya-studio-integration.md）。
    - name: zmk
      remote: cormoran
      revision: v0.3-branch+dya
      import: app/west.yml
    # DYA Studio Level 2: BLEプロファイル管理・設定同期・トラックボール速度調整。
    # zmk-module-ble-management・zmk-module-runtime-input-processorは、mainブランチ
    # HEADが（DYA本体が使う）ZMK本家main相当のより新しいコアAPI
    # （zmk_keymap_layer_activateの2引数版、zmk_endpoint_*の単数形命名等）に依存して
    # おり、v0.3ベースの本フォークとはリンクエラーになるため、両モジュールともその
    # 変更が入る前のコミットに固定している（詳細はmemos/dya-studio-integration.md）。
    # zmk-module-settings-rpcはそのようなAPIを使っておらずmainのままで問題ない。
    - name: zmk-module-ble-management
      remote: cormoran
      revision: 2147ba7d329253ef9d0cfe4c6b814add7915225c
    - name: zmk-module-settings-rpc
      remote: cormoran
      revision: main
    - name: zmk-module-runtime-input-processor
      remote: cormoran
      revision: dbf92f764de8b6ffd60bf5850514302875fe2570
    # DYA Studio Level 2: Combo編集・キー入力ストリーム表示・機体情報表示。
    # zmk-feature-runtime-comboはzmk-feature-custom-settingsに依存する。
    # custom-settingsのmainブランチHEADは内部でzephyr_linker_sources(ROM_SECTIONS ...)
    # を呼ぶが、ROM_SECTIONSはこのキーボードが使うZephyr v3.5.0+zmk-fixesの
    # extensions.cmakeには存在しない（より新しいZephyrで追加されたリンカ配置先）。
    # 単純な日付ベースのコミット選定は、並行開発されたブランチのマージ順序次第で
    # 一見「古い」コミットが実は必要な機能を含んでいない場合があり通用しなかった
    # （試行錯誤の詳細はmemos/dya-studio-integration.md）。最終的にmainブランチの
    # 履歴を辿り、ROM_SECTIONSを導入したマージコミットの直前（=関連PRが
    # 全てマージされた後の最後の状態）に固定。runtime-comboが参照する
    # custom-settingsのシンボル・マクロが全て存在することを確認済み。
    - name: zmk-feature-custom-settings
      remote: cormoran
      revision: 5be86dcfb903ecc12624b02cadb40bbdbc78abe3
    - name: zmk-feature-runtime-combo
      remote: cormoran
      revision: main
    # zmk-feature-runtime-macroのmainブランチHEADは、custom-settingsを
    # keyspace方式のストレージへ作り直した後のAPI(zmk_custom_settings_notify_
    # suppress_begin/end等)を使い、上のcustom-settings固定コミットには存在
    # しない。そのストレージ書き換え(2026-07-08)より前、かつcustom-settings
    # 固定コミットが要求する範囲のAPIしか使わないコミットに固定
    # （詳細はmemos/dya-studio-integration.md）。
    - name: zmk-feature-runtime-macro
      remote: cormoran
      revision: 0a7c3bcefb63f479fe0292aaff2301f2c0440543
    - name: zmk-feature-input-stream
      remote: cormoran
      revision: main
    # DYA Studio: 診断用ポップアップ(ログ表示・Studioロック状態の確認/切替)。
    # devtool_layer.c(レイヤー状態の取得/切替RPC、デフォルト有効)はzmk_keymap_
    # layer_activate/toggleを2引数で呼び、v0.3-branch+dyaとリンクエラーになる
    # ため、CONFIG_ZMK_DEVTOOL_LAYER_STATE=nで明示的に無効化する
    # （詳細はmemos/dya-studio-integration.md）。
    - name: zmk-module-devtool
      remote: cormoran
      revision: main
    # zmk-feature-device-infoもmainブランチHEADは同様にzephyr_linker_sources(ROM_SECTIONS
    # ...)（GNU build-idをビルドに埋め込む機能）を使い非互換なため、その機能が入る前の
    # コミットに固定。device-infoはZMKコアAPIを一切呼ばないため機能面での実質的な差分は
    # build-id埋め込みのみ。なお#include <zephyr/version.h>もこのZephyrバージョンには
    # 存在しないパスで（新旧どのコミットでも共通）、リポジトリ直下の
    # include/zephyr/version.h の互換シムで解決している
    # （詳細はmemos/dya-studio-integration.md）。
    - name: zmk-feature-device-info
      remote: cormoran
      revision: b1bb753608c3d57a8071419405eb8b3b4bd5a961
    - name: zmk-component-bmp-boost
      remote: sekigon-gonnoc
      import: west.yml
      revision: v0.2
    - name: zmk-feature-status-led
      remote: sekigon-gonnoc
      revision: main
    - name: zmk-driver-paw3222
      remote: sekigon-gonnoc
      revision: torabo-tsuki
    - name: zmk-driver-iqs7211e
      remote: sekigon-gonnoc
    - name: zmk-feature-cdc-acm-bootloader-trigger
      remote: sekigon-gonnoc
      revision: v0.2
    - name: zmk-feature-non-lipo-battery-management
      remote: sekigon-gonnoc
      revision: main
    - name: zmk-scroll-snap
      remote: kot149
      revision: v1
    - name: zmk-layout-shift
      remote: kot149
      revision: v2
  self:
    path: config
```
